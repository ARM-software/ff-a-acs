/*
 * Copyright (c) 2021-2025, Arm Limited or its affiliates. All rights reserved.
 *
 * SPDX-License-Identifier: BSD-3-Clause
 *
 */

/dts-v1/;

/ {
    compatible = "arm,ffa-manifest-1.0";

    /* Properties */
    description = "Base-1";
    ffa-version = <0x00010002>; /* 31:16 - Major, 15:0 - Minor */
    uuid = <0x735cb579 0xb9448c1d 0xe1619385 0xd2d80a77>;
    id = <3>;
    auxiliary-id = <0xae>;
    stream-endpoint-ids = <0 1 2 3>;
    execution-ctx-count = <1>;
    exception-level = <2>; /* S-EL1 */
    execution-state = <0>; /* AARCH64 */
    load-address = <0x7400000>;
    entrypoint-offset = <0x4000>;
    xlat-granule = <0>; /* 4KiB */
    boot-order = <2>;
    notification-support;
    messaging-method = <0x603>; /* Direct messaging/Direct messaging-2 only */
    ns-interrupts-action = <0>; /* Non secure interrupts are queued. */

    /* Boot protocol */
    gp-register-num = <0x0>;

};
