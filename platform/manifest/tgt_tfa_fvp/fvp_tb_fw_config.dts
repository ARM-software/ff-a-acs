/*
 * Copyright (c) 2022, Arm Limited or its affiliates. All rights reserved.
 *
 * SPDX-License-Identifier: BSD-3-Clause
 */

#ifdef OPTEE_SP_FW_CONFIG
        op-tee {
            uuid = "486178e0-e7f8-11e3-bc5e-0002a5d5c51b";
            load-address = <0x6280000>;
        };
#else
        vm1 {
            uuid = "b4b5671e-4a90-4fe1-b81f-fb13dae1dacb";
            load-address = <0x7000000>;
            owner = "SiP";
        };

        vm2 {
            uuid = "d1582309-f023-47b9-827c-4464f5578fc8";
            load-address = <0x7100000>;
            owner = "Plat";
        };

        vm3 {
            uuid = "79b55c73-1d8c-44b9-8593-61e1770ad8d2";
            load-address = <0x7200000>;
            owner = "Plat";
        };

#endif
